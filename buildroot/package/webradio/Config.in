## buildroot/package/webradio/Config.in
```kconfig
config BR2_PACKAGE_WEBRADIO
	bool "webradio"
        help
	  Support for web radio.
        depends on BR2_PACKAGE_HIFIBERRY_BASE
        depends on BR2_PACKAGE_BEOCREATE
	select BR2_PACKAGE_LIBCURL
	select BR2_PACKAGE_LIBCURL_CURL
	select BR2_PACKAGE_MPD_MPC
```
